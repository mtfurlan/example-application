## boards/arm/d2v_hdk4/Kconfig.board
```kconfig
# D2V HDK v4 NRF5340 board configuration

# Copyright (c) 2019-2020 Nordic Semiconductor ASA
# SPDX-License-Identifier: Apache-2.0

if SOC_NRF5340_CPUAPP_QKAA

config BOARD_D2V_HDK4_CPUAPP
	bool "D2V HDK v4 nRF5340 Application MCU"

endif # SOC_NRF5340_CPUAPP_QKAA

config BOARD_D2V_HDK4_CPUNET
	bool "D2V HDK v4 NRF5340 Network MCU"
	depends on SOC_NRF5340_CPUNET_QKAA
```

## boards/arm/d2v_hdk4/Kconfig.defconfig
```kconfig
# D2V HDK v4 nRF5340 board configuration

# Copyright (c) 2019-2020 Nordic Semiconductor ASA
# SPDX-License-Identifier: Apache-2.0

if  BOARD_D2V_HDK4_CPUAPP

config BOARD
	default "d2v_hdk4_cpuapp" if BOARD_D2V_HDK4_CPUAPP

config I2C
	default y

# By default, if we build for a Non-Secure version of the board,
# enable building with TF-M as the Secure Execution Environment.
config BUILD_WITH_TFM
	default n

if BUILD_WITH_TFM

# By default, if we build with TF-M, instruct build system to
# flash the combined TF-M (Secure) & Zephyr (Non Secure) image
config TFM_FLASH_MERGED_BINARY
	bool
	default y

endif # BUILD_WITH_TFM

# Code Partition:
#
# For the secure version of the board the firmware is linked at the beginning
# of the flash, or into the code-partition defined in DT if it is intended to
# be loaded by MCUboot. If the secure firmware is to be combined with a non-
# secure image (TRUSTED_EXECUTION_SECURE=y), the secure FW image shall always
# be restricted to the size of its code partition.
#
# For the non-secure version of the board, the firmware
# must be linked into the code-partition (non-secure) defined in DT, regardless.
# Apply this configuration below by setting the Kconfig symbols used by
# the linker according to the information extracted from DT partitions.

# SRAM Partition:
#
# If the secure firmware is to be combined with a non-secure image
# (TRUSTED_EXECUTION_SECURE=y), the secure FW image SRAM shall always
# be restricted to the secure image SRAM partition (sram-secure-partition).
# Otherwise (if TRUSTED_EXECUTION_SECURE is not set) the whole zephyr,sram
# may be used by the image.
#
# For the non-secure version of the board, the firmware image SRAM is
# always restricted to the allocated non-secure SRAM partition.
#
# Workaround for not being able to have commas in macro arguments
DT_CHOSEN_Z_CODE_PARTITION := zephyr,code-partition
DT_CHOSEN_Z_SRAM_PARTITION := zephyr,sram-secure-partition

if BOARD_D2V_HDK4_CPUAPP && TRUSTED_EXECUTION_SECURE

config FLASH_LOAD_SIZE
	default $(dt_chosen_reg_size_hex,$(DT_CHOSEN_Z_CODE_PARTITION))

config SRAM_SIZE
	default $(dt_chosen_reg_size_int,$(DT_CHOSEN_Z_SRAM_PARTITION),0,K)

endif # BOARD_D2V_HDK4_CPUAPP && TRUSTED_EXECUTION_SECURE

endif # BOARD_D2V_HDK4_CPUAPP

config BOARD
	default "d2v_hdk4_cpunet" if BOARD_D2V_HDK4_CPUNET

config MBOX_NRFX_IPC
	default MBOX

if BOARD_D2V_HDK4_CPUAPP

choice BT_HCI_BUS_TYPE
	default BT_RPMSG if BT
endchoice

config HEAP_MEM_POOL_SIZE
	default 4096 if BT_RPMSG

endif #  BOARD_D2V_HDK4_CPUAPP

if BOARD_D2V_HDK4_CPUNET

config BT_CTLR
	default y if BT

endif # BOARD_D2V_HDK4_CPUNET

config UART_NRF_DK_SERIAL_WORKAROUND
	default y if ZTEST

# When the nRF DK serial workaround is enabled, increase the stack size in
# tests built with no optimizations, as the standard size may be insufficient
# then. Use 512 to align with the FPU_SHARING case, where the default value
# is also modified.
config TEST_EXTRA_STACK_SIZE
	default 512 if UART_NRF_DK_SERIAL_WORKAROUND && NO_OPTIMIZATIONS
```

## boards/arm/d2v_hdk4/d2v_hdk4_cpunet_defconfig
```kconfig
# SPDX-License-Identifier: Apache-2.0

CONFIG_SOC_SERIES_NRF53X=y
CONFIG_SOC_NRF5340_CPUNET_QKAA=y
CONFIG_BOARD_D2V_HDK4_CPUNET=y

# Enable MPU
CONFIG_ARM_MPU=y

# Enable hardware stack protection
CONFIG_HW_STACK_PROTECTION=y

# enable GPIO
CONFIG_GPIO=y

CONFIG_PINCTRL=y
```

## dts/bindings/sensor/ublox,ubxlib-shim.yaml
```yaml
description: |
  A shim to put ubxlib in the devicetree

  Example definition in devicetree:

    examplesensor {
        compatible = "zephyr,examplesensor";
        input-gpios = <&gpio0 0 (GPIO_PULL_UP | GPIO_ACTIVE_LOW)>;
    };

compatible: "ublox,ubxlib-shim"

include: base.yaml

properties:
  bus-type:
    type: int
    enum:
      - 0
      - 1
    required: true
    description: type of bus it's on, 0=spi, 1=i2c
  bus-num:
    type: int
    required: true
    description: what number bus it's on (4 for spi4, for example)
  module-type:
    type: int
    enum:
      - 0
      - 1
      - 2
    required: true
    description: What type of ublox module, M8=0, M9=1, M10=2
```

## west.yml
```yaml
# Copyright (c) 2021 Nordic Semiconductor ASA
# SPDX-License-Identifier: Apache-2.0

manifest:
  self:
    west-commands: scripts/west-commands.yml

  remotes:
    - name: zephyrproject-rtos
      url-base: https://github.com/zephyrproject-rtos
    - name: ublox
      url-base: git@github.com:u-blox
    - name: mtfurlan
      url-base: git@github.com:mtfurlan

  projects:
    - name: zephyr
      remote: zephyrproject-rtos
      revision: v3.3.0
      import: true
    - name: ubxlib
      remote: mtfurlan
      path: ubxlib
      revision: build/unity-via-in-zephyr
      import: true
```
